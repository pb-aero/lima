// AeroVault: bind the W25N01GV (Flash 5 Click) on Pi 5 SPI0 CE0 to the kernel's
// spi-nand / MTD stack instead of talking to it by hand through spidev.
//
// This REPLACES spidev0.0 — the two cannot share a chip select. Probe with
// w25n01gv-probe.py FIRST, then install this.
//
// Build + install:
//   dtc -@ -I dts -O dtb -o w25n01gv.dtbo w25n01gv-spi-nand-overlay.dts
//   sudo cp w25n01gv.dtbo /boot/firmware/overlays/
//   then in /boot/firmware/config.txt:
//       dtoverlay=spi0-1cs        # NOT spi0-0cs — the NAND needs a real CS on GPIO8
//       dtoverlay=w25n01gv
//   reboot, then: cat /proc/mtd   ->  expect one 128 MiB device
//
// Keep the comment on its own line. config.txt does not reliably parse a trailing
// "#" on a dtoverlay= line — that scar is already in this repo twice.

/dts-v1/;
/plugin/;

/ {
	compatible = "brcm,bcm2712";

	fragment@0 {
		target = <&spidev0>;
		__overlay__ {
			status = "disabled";
		};
	};

	fragment@1 {
		target = <&spi0>;
		__overlay__ {
			status = "okay";
			#address-cells = <1>;
			#size-cells = <0>;

			flash@0 {
				compatible = "jedec,spi-nand";
				reg = <0>;
				/* 1 MHz with a 300 us chip-select gap. This is SLOW ON PURPOSE.
				   A 2026-09-16 tuning attempt raised it to 25 MHz/20 us and then
				   10 MHz/100 us. Both passed a 64-page write test and BOTH FAILED
				   the real one: 25 MHz corrupted a 16 MiB file, and 10 MHz passed
				   the checksum while quietly marking good blocks bad — it consumed
				   nine of the part's eighteen spare blocks in a single pass.
				   Do not raise these numbers again without running the FULL
				   ubi-verify AND checking /sys/class/mtd/mtd0/bad_blocks either
				   side of it. The fix for throughput is wiring, not parameters. */
				spi-max-frequency = <1000000>;

				spi-cs-inactive-delay-ns = <300000>;
				spi-cs-setup-delay-ns = <1000>;
				spi-cs-hold-delay-ns = <1000>;
				status = "okay";
			};
		};
	};
};
